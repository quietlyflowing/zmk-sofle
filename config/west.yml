## config/west.yml
```yaml
manifest:
  remotes:
    - name: zmkfirmware
      url-base: https://github.com/zmkfirmware
    - name: quietlyflowing
      url-base: https://github.com/quietlyflowing
    - name: badjeff
      url-base: https://github.com/badjeff
      # Additional modules containing boards/shields/custom code can be listed here as well.
      # See:
      # - https://zmk.dev/docs/features/modules
      # - https://docs.zephyrproject.org/3.5.0/develop/west/manifest.html#projects
  #  - name: gpeye
  #    url-base: https://github.com/GPeye
  projects:
   # - name: mario-peripheral-animation
   #   remote: gpeye
   #    revision: main 
    - name: eyelash_sofle
      url: https://github.com/a741725193/zmk-sofle
      revision: main
    - name: zmk-hid-io-plover-hid
      remote: quietlyflowing
      revision: main
    # Haptic feedback test (smoke-test v0.3.0 compat) — see try-haptic-drv2605 branch
    - name: zmk-output-behavior-listener
      remote: badjeff
      revision: main
    - name: zmk
      remote: zmkfirmware
      revision: v0.3.0
      import: app/west.yml
  self:
    path: boards
```
